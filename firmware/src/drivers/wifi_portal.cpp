#include "wifi_portal.h"
#include <WiFi.h>
#include "config.h"

using wifisetup::Check;
using wifisetup::Session;

// The setup page: one file, no outside resources (a phone on dino's network has no internet).
// Network names are put into the page with textContent, never as HTML.
static const char PAGE[] PROGMEM = R"HTML(<!doctype html><html><head><meta charset="utf-8">
<meta name="viewport" content="width=device-width,initial-scale=1"><title>Connect your Dino</title>
<style>
/* Pixling brand language: Night #282020, cream #FCF8F0, teal #2F9083. Whole cells (4 px), stepped corners, no curves,
   no outside fonts (a phone on dino's network has no internet). The art below is generated by tools/gen_portal_art.py. */
:root{--bg:#282020;--ink:#FCF8F0;--mut:#C9C0B4;--line:#FCF8F0;--field:#332a2a;--teal:#2F9083;--btn:#FCF8F0;--btnink:#282020}
@media (prefers-color-scheme:light){:root{--bg:#FCF8F0;--ink:#282020;--mut:#5d524a;--line:#282020;--field:#fff;--btn:#282020;--btnink:#FCF8F0}}
*{box-sizing:border-box}
body{margin:0;background:var(--bg);color:var(--ink);font:17px/1.55 "Atkinson Hyperlegible",system-ui,-apple-system,"Segoe UI",sans-serif}
main{max-width:440px;margin:0 auto;padding:28px 20px 40px}
.logo{display:block;width:184px;height:auto;color:var(--ink);overflow:visible}
.logo .dot{fill:var(--teal);animation:hop 4s steps(1) infinite}
@keyframes hop{0%,92%{transform:translateY(0)}94%,97%{transform:translateY(-2px)}100%{transform:translateY(0)}}
.hero{display:flex;align-items:flex-end;gap:16px;margin:28px 0 12px}
.dino{width:96px;height:auto;color:var(--ink);flex:none}
.dino path[class^=f-]{display:none}
body[data-f=open] .f-open,body[data-f=half] .f-half,body[data-f=happy] .f-happy{display:inline}
h1{font-size:26px;line-height:1.15;margin:0}
p{margin:0 0 16px;color:var(--mut)}
label{display:block;margin:20px 0 6px;font-weight:700}
.cut{clip-path:polygon(0 4px,4px 4px,4px 0,calc(100% - 4px) 0,calc(100% - 4px) 4px,100% 4px,100% calc(100% - 4px),calc(100% - 4px) calc(100% - 4px),calc(100% - 4px) 100%,4px 100%,4px calc(100% - 4px),0 calc(100% - 4px))}
select,input[type=text],input[type=password]{width:100%;padding:12px;font:inherit;border:4px solid var(--line);border-radius:0;background:var(--field);color:var(--ink)}
select:focus,input:focus,button:focus-visible{outline:4px solid var(--teal);outline-offset:0}
button{width:100%;margin-top:24px;padding:14px;font:inherit;font-weight:700;font-size:19px;border:0;border-radius:0;background:var(--btn);color:var(--btnink);cursor:pointer}
button.alt{margin-top:8px;padding:8px;background:none;color:var(--mut);font-weight:400;font-size:17px;text-decoration:underline}
button:disabled{opacity:.5}
#msg{min-height:3.2em;margin:16px 0 0;color:var(--ink);border-left:4px solid var(--teal);padding-left:12px}
#msg:empty{border-left-color:transparent}
small{display:block;color:var(--mut);margin-top:20px;font-size:15px}
.row{display:flex;align-items:center;gap:10px;margin-top:10px;font-weight:400}
.row input{width:20px;height:20px;accent-color:var(--teal)}
@media (prefers-reduced-motion:reduce){.logo .dot{animation:none}}
</style></head><body data-f="open"><main>
<!--logo--><svg class="logo" viewBox="0 0 46 12" role="img" aria-label="Pixling" shape-rendering="crispEdges"><path fill="currentColor" d="M0 0h6v1h-6zM22 0h2v1h-2zM26 0h2v1h-2zM0 1h7v1h-7zM22 1h2v1h-2zM26 1h2v1h-2zM0 2h2v1h-2zM5 2h2v1h-2zM22 2h2v1h-2zM0 3h2v1h-2zM5 3h2v1h-2zM9 3h2v1h-2zM13 3h2v1h-2zM18 3h2v1h-2zM22 3h2v1h-2zM26 3h2v1h-2zM30 3h6v1h-6zM40 3h6v1h-6zM0 4h2v1h-2zM5 4h2v1h-2zM9 4h2v1h-2zM13 4h2v1h-2zM18 4h2v1h-2zM22 4h2v1h-2zM26 4h2v1h-2zM30 4h7v1h-7zM39 4h7v1h-7zM0 5h7v1h-7zM9 5h2v1h-2zM14 5h2v1h-2zM17 5h2v1h-2zM22 5h2v1h-2zM26 5h2v1h-2zM30 5h2v1h-2zM35 5h2v1h-2zM39 5h2v1h-2zM44 5h2v1h-2zM0 6h6v1h-6zM9 6h2v1h-2zM15 6h3v1h-3zM22 6h2v1h-2zM26 6h2v1h-2zM30 6h2v1h-2zM35 6h2v1h-2zM39 6h2v1h-2zM44 6h2v1h-2zM0 7h2v1h-2zM9 7h2v1h-2zM14 7h2v1h-2zM17 7h2v1h-2zM22 7h2v1h-2zM26 7h2v1h-2zM30 7h2v1h-2zM35 7h2v1h-2zM39 7h2v1h-2zM44 7h2v1h-2zM0 8h2v1h-2zM9 8h2v1h-2zM13 8h2v1h-2zM18 8h2v1h-2zM22 8h2v1h-2zM26 8h2v1h-2zM30 8h2v1h-2zM35 8h2v1h-2zM39 8h7v1h-7zM0 9h2v1h-2zM9 9h2v1h-2zM13 9h2v1h-2zM18 9h2v1h-2zM22 9h2v1h-2zM26 9h2v1h-2zM30 9h2v1h-2zM35 9h2v1h-2zM40 9h6v1h-6zM44 10h2v1h-2zM39 11h6v1h-6z"/><rect class="dot" x="9" y="0" width="2" height="2"/></svg><!--/logo-->
<div class="hero"><!--dino--><svg class="dino" viewBox="0 0 24 23" role="img" aria-label="Dino" shape-rendering="crispEdges"><path fill="currentColor" d="M11 0h2v1h-2zM2 1h1v1h-1zM9 1h1v1h-1zM11 1h2v1h-2zM14 1h1v1h-1zM21 1h1v1h-1zM2 2h2v1h-2zM9 2h6v1h-6zM20 2h2v1h-2zM2 3h3v1h-3zM7 3h10v1h-10zM19 3h3v1h-3zM3 4h1v1h-1zM5 4h14v1h-14zM20 4h1v1h-1zM3 5h18v1h-18zM3 6h4v1h-4zM17 6h4v1h-4zM3 7h3v1h-3zM18 7h3v1h-3zM3 8h3v1h-3zM18 8h3v1h-3zM3 9h3v1h-3zM18 9h3v1h-3zM3 10h3v1h-3zM18 10h3v1h-3zM3 11h3v1h-3zM18 11h3v1h-3zM3 12h3v1h-3zM18 12h3v1h-3zM3 13h4v1h-4zM17 13h4v1h-4zM3 14h18v1h-18zM1 15h1v1h-1zM3 15h18v1h-18zM22 15h1v1h-1zM0 16h2v1h-2zM3 16h18v1h-18zM22 16h2v1h-2zM0 17h2v1h-2zM3 17h18v1h-18zM22 17h2v1h-2zM1 18h1v1h-1zM3 18h18v1h-18zM22 18h1v1h-1zM3 19h18v1h-18zM4 20h16v1h-16zM4 21h6v1h-6zM14 21h6v1h-6zM4 22h6v1h-6zM14 22h6v1h-6z"/><path class="f-open" fill="currentColor" d="M8 8h1v1h-1zM9 8h1v1h-1zM14 8h1v1h-1zM15 8h1v1h-1zM8 9h1v1h-1zM9 9h1v1h-1zM14 9h1v1h-1zM15 9h1v1h-1zM10 11h1v1h-1zM13 11h1v1h-1zM11 12h1v1h-1zM12 12h1v1h-1z"/><path class="f-half" fill="currentColor" d="M8 9h1v1h-1zM9 9h1v1h-1zM14 9h1v1h-1zM15 9h1v1h-1zM11 12h1v1h-1zM12 12h1v1h-1z"/><path class="f-closed" fill="currentColor" d="M7 9h1v1h-1zM8 9h1v1h-1zM9 9h1v1h-1zM14 9h1v1h-1zM15 9h1v1h-1zM16 9h1v1h-1zM10 12h1v1h-1zM11 12h1v1h-1zM12 12h1v1h-1zM13 12h1v1h-1z"/><path class="f-happy" fill="currentColor" d="M9 8h1v1h-1zM14 8h1v1h-1zM8 9h1v1h-1zM10 9h1v1h-1zM13 9h1v1h-1zM15 9h1v1h-1zM10 11h1v1h-1zM13 11h1v1h-1zM11 12h1v1h-1zM12 12h1v1h-1z"/></svg><!--/dino--><h1>Connect your Dino</h1></div>
<p>So it can show the time. Dino only uses Wi-Fi to ask for the time, about once a day.</p>
<label for="n">Your Wi-Fi network</label>
<select id="n" class="cut"><option value="">Looking for networks...</option></select>
<button class="alt" id="r" type="button">Look again</button>
<label for="m">Or type its name</label><input id="m" class="cut" type="text" autocomplete="off" autocapitalize="off" maxlength="32">
<label for="p">Wi-Fi password</label><input id="p" class="cut" type="password" autocomplete="off" maxlength="63">
<label class="row"><input type="checkbox" id="s"> Show password</label>
<button id="go" class="cut" type="button">Connect</button>
<p id="msg" role="status"></p>
<small>Dino can only use 2.4 GHz networks. Your password goes to dino only, over its own network, and is kept on dino.</small>
<script>
const $=i=>document.getElementById(i);let busy=false;
const say=(t,f)=>{$('msg').textContent=t;document.body.dataset.f=f||'open'};
async function scan(){
  try{const r=await(await fetch('/scan')).json();
    if(!r.done){setTimeout(scan,1000);return}
    const n=$('n');n.textContent='';
    r.list.forEach(x=>{const o=document.createElement('option');o.value=x.s;o.textContent=x.s+(x.o?'':' (open)');n.appendChild(o)});
    if(!r.list.length){const o=document.createElement('option');o.value='';o.textContent='No networks found';n.appendChild(o)}
  }catch(e){setTimeout(scan,2000)}
}
$('r').onclick=async()=>{$('n').textContent='';await fetch('/scan?again=1');scan()};
$('s').onchange=()=>{$('p').type=$('s').checked?'text':'password'};
async function poll(){
  try{const r=await(await fetch('/status')).json();
    if(r.state==='done'){say('Connected! Dino is getting the time. You can close this page.','happy');return}
    if(r.state==='failed'){busy=false;$('go').disabled=false;say('Dino could not connect. Check the password and that it is a 2.4 GHz network, then try again.','half');return}
  }catch(e){}
  setTimeout(poll,1000);
}
$('go').onclick=async()=>{
  if(busy)return;
  const ssid=$('m').value||$('n').value;
  if(!ssid){say('Pick your Wi-Fi network first.');return}
  busy=true;$('go').disabled=true;say('Connecting...');
  const body=new URLSearchParams({ssid:ssid,pass:$('p').value}).toString();
  try{const r=await(await fetch('/save',{method:'POST',headers:{'Content-Type':'text/plain'},body:body})).json();
    if(!r.ok){busy=false;$('go').disabled=false;say(r.msg,'half');return}
    poll();
  }catch(e){busy=false;$('go').disabled=false;say('Lost dino. Check that your phone is still on the DINO network.','half')}
};
scan();
</script></main></body></html>)HTML";

static const IPAddress AP_IP(192, 168, 4, 1);

bool WifiPortal::start(const char* apName, const char* apPassword, Session& session) {
  stop();
  session_ = &session;
  WiFi.mode(WIFI_AP_STA);  // the station side is for trying the home Wi-Fi and for scanning
  WiFi.softAPConfig(AP_IP, AP_IP, IPAddress(255, 255, 255, 0));
  if (!WiFi.softAP(apName, apPassword, 1, 0, WIFI_SETUP_MAX_PHONES)) {
    Serial.println("[wifi] could not start the setup network");
    WiFi.mode(WIFI_OFF);
    return false;
  }
#if WIFI_LOW_TX_POWER
  WiFi.setTxPower(WIFI_POWER_8_5dBm);
#endif
  dns_.setErrorReplyCode(DNSReplyCode::NoError);
  dns_.start(53, "*", AP_IP);  // every name -> dino: phones notice the "sign in" page and open it
  routes();
  web_.begin();
  scanning_ = false;
  scanDoneMs_ = 0;
  startScan();  // look for networks now, while no phone is on the network yet (a scan makes the radio hop channels)
  lastState_ = session.state();
  running_ = true;
  Serial.printf("[wifi] setup network \"%s\" is up\n", apName);
  return true;
}

void WifiPortal::stop() {
  if (!running_) return;
  web_.stop();
  dns_.stop();
  WiFi.scanDelete();
  WiFi.softAPdisconnect(true);
  WiFi.disconnect(true);
  WiFi.mode(WIFI_OFF);
  running_ = false;
  Serial.println("[wifi] setup network is down");
}

void WifiPortal::routes() {
  web_.on("/", HTTP_GET, [this]() { sendPage(); });
  web_.on("/scan", HTTP_GET, [this]() { sendScan(); });
  web_.on("/save", HTTP_POST, [this]() { sendSave(); });
  web_.on("/status", HTTP_GET, [this]() { sendStatus(); });
  web_.onNotFound([this]() { redirectHome(); });  // /generate_204, /hotspot-detect.html, /connecttest.txt ...: the "sign in" probes
}

void WifiPortal::reply(int code, const char* json) {
  web_.sendHeader("Cache-Control", "no-store");
  web_.send(code, "application/json", json);
}

void WifiPortal::sendPage() {
  web_.sendHeader("Cache-Control", "no-store");
  web_.send_P(200, "text/html", PAGE);
}

void WifiPortal::redirectHome() {
  web_.sendHeader("Location", "http://192.168.4.1/", true);
  web_.send(302, "text/plain", "");
}

void WifiPortal::startScan() {
  if (scanning_) return;
  WiFi.scanDelete();
  WiFi.scanNetworks(true);  // async: the loop keeps running
  scanning_ = true;
}

// {"done":false} while scanning, then {"done":true,"list":[{"s":"name","o":1},...]} (o = 1 when it has a password).
void WifiPortal::sendScan() {
  if (web_.hasArg("again")) {
    startScan();
    reply(200, "{\"done\":false}");
    return;
  }
  if (scanning_) { reply(200, "{\"done\":false}"); return; }
  const int n = WiFi.scanComplete();
  if (n < 0) { startScan(); reply(200, "{\"done\":false}"); return; }
  String out = "{\"done\":true,\"list\":[";
  int listed = 0;
  String seen[WIFI_SETUP_SCAN_MAX];
  for (int i = 0; i < n && listed < WIFI_SETUP_SCAN_MAX; i++) {
    const String name = WiFi.SSID(i);
    if (!name.length() || name.length() > wifisetup::SSID_MAX) continue;  // hidden or unusable
    bool dup = false;
    for (int k = 0; k < listed; k++) if (seen[k] == name) { dup = true; break; }
    if (dup) continue;
    char esc[2 * wifisetup::SSID_MAX + 8];
    if (!wifisetup::jsonString(name.c_str(), esc, sizeof esc)) continue;
    if (listed) out += ',';
    out += "{\"s\":";
    out += esc;
    out += WiFi.encryptionType(i) == WIFI_AUTH_OPEN ? ",\"o\":0}" : ",\"o\":1}";
    seen[listed++] = name;
  }
  out += "]}";
  reply(200, out.c_str());
}

// POST text/plain "ssid=..&pass=..". The session decides whether it is usable; if it is, dino starts joining.
void WifiPortal::sendSave() {
  const String body = web_.arg("plain");
  char ssid[wifisetup::SSID_MAX + 2] = "", pass[wifisetup::PASSPHRASE_MAX + 2] = "";
  // formValue is false when a field is missing or does not fit in the buffer (one byte longer than allowed), so a
  // too-long password is refused here and never turns into an empty one (= an open network).
  Check c = Check::BadChars;
  if (body.length() > 0 && body.length() < 400) {
    if (!wifisetup::formValue(body.c_str(), "ssid", ssid, sizeof ssid)) c = Check::SsidTooLong;
    else if (!wifisetup::formValue(body.c_str(), "pass", pass, sizeof pass)) c = Check::PassTooLong;
    else c = session_->submit(ssid, pass, millis());
  }
  if (c != Check::Ok) {
    String out = "{\"ok\":false,\"msg\":\"";
    out += wifisetup::checkMessage(c);
    out += "\"}";
    reply(200, out.c_str());
    return;
  }
  Serial.printf("[wifi] trying \"%s\"\n", session_->ssid());  // the password is never printed
  WiFi.scanDelete();
  scanning_ = false;
  WiFi.begin(session_->ssid(), session_->pass());
  reply(200, "{\"ok\":true}");
}

void WifiPortal::sendStatus() {
  const char* st = "waiting";
  switch (session_->state()) {
    case Session::State::Connecting: st = "connecting"; break;
    case Session::State::Done: st = "done"; break;
    default: st = session_->lastFailed() ? "failed" : "waiting"; break;
  }
  String out = "{\"state\":\"";
  out += st;
  out += "\"}";
  reply(200, out.c_str());
}

void WifiPortal::loop(uint32_t now) {
  if (!running_) return;
  dns_.processNextRequest();
  web_.handleClient();
  if (scanning_ && WiFi.scanComplete() != WIFI_SCAN_RUNNING) { scanning_ = false; scanDoneMs_ = now; }

  Session& s = *session_;
  if (s.state() != Session::State::Connecting) s.onStations(WiFi.softAPgetStationNum(), now);
  if (s.state() == Session::State::Connecting) {
    const wl_status_t w = WiFi.status();
    if (w == WL_CONNECTED) s.onConnectResult(true, now);
    else if (w == WL_CONNECT_FAILED || w == WL_NO_SSID_AVAIL) s.onConnectResult(false, now);  // refused / not found: no need to wait
  }
  s.tick(now);
  if (lastState_ == Session::State::Connecting && s.state() != Session::State::Connecting &&
      s.state() != Session::State::Done) {
    WiFi.disconnect(false);  // gave up on this try: stop retrying in the background (the AP stays up)
    Serial.println("[wifi] could not join that network");
  }
  lastState_ = s.state();
}
